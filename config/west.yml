## config/west.yml
```yaml
manifest:
  remotes:
    - name: zmkfirmware
      url-base: https://github.com/zmkfirmware
      url-base: https://github.com/m-keppler
    - name: m-keppler
  projects:
    - name: zmk
      remote: zmkfirmware
      revision: v0.3 # pinned
      import: app/west.yml
    - name: zmk-keyboard-totem
      remote: m-keppler
      revision: main
  self:
    path: config
```
